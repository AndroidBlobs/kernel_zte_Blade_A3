/*
 * Spreadtrum SP9850E board common DTS file
 *
 * Copyright (C) 2017, Spreadtrum Communications Inc.
 *
 * This file is licensed under a dual GPLv2 or X11 license.
 */

#include "sc9850e.dtsi"
#include "sharkle-board-common.dtsi"
